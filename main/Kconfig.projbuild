## main/Kconfig.projbuild
```kconfig
menu "Panda Pocket"

    config PP_MOCK_MODE
        bool "Mock Mode: bus and route data come from built-in fixtures"
        default y
        help
            Forces fixtures even when API credentials are present.

    config PP_LTA_ACCOUNT_KEY
        string "LTA DataMall AccountKey (dev only; put it in sdkconfig.secrets)"
        default ""

    config PP_ONEMAP_TOKEN
        string "OneMap API token (dev only; expires, put it in sdkconfig.secrets)"
        default ""

    config PP_WIFI_SSID
        string "Default Wi-Fi SSID (dev only)"
        default ""

    config PP_WIFI_PASSWORD
        string "Default Wi-Fi password (dev only)"
        default ""

    config PP_LOW_POWER
        bool "Low power: light sleep while the screen is off"
        default y
        help
            Screen off pauses the UI and light-sleeps until a side key or the power key.
            Touch cannot wake it. Off: only the panel sleeps and touch wakes it.

    config PP_SCREEN_OFF_S
        int "Screen off after idle seconds"
        range 5 600
        default 30

endmenu
```
